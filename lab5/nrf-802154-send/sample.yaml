## lab5/nrf-802154-send/sample.yaml
```yaml
sample:
  description: IEEE 802.15.4 PHY Test Tool sample
  name: IEEE 802.15.4 PHY Test Tool
tests:
  sample.peripheral.802154_phy_test:
    build_only: true
    integration_platforms:
      - nrf52840dk/nrf52840
      - nrf21540dk/nrf52840
      - nrf5340dk/nrf5340/cpunet
      - nrf54l15dk/nrf54l15/cpuapp
    platform_allow: 
      - nrf52840dk/nrf52840
      - nrf21540dk/nrf52840
      - nrf5340dk/nrf5340/cpunet
      - nrf54l15dk/nrf54l15/cpuapp
    tags: ci_build
```

## lab5/timer/build/Kconfig/boards/Kconfig
```kconfig
# Load Zephyr board Kconfig descriptions.
osource "/opt/nordic/ncs/v3.2.1/zephyr/boards/ezurio/bl54l15_dvk/Kconfig"
```

## lab5/timer/build/timer/Kconfig/boards/Kconfig.defconfig
```kconfig
# Load Zephyr board defconfig descriptions.
osource "/opt/nordic/ncs/v3.2.1/zephyr/boards/ezurio/bl54l15_dvk/Kconfig.defconfig"
```
